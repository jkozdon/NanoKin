## config/boards/shields/nanokin/Kconfig.shield
```kconfig
# Copyright (c) 2022 The ZMK Contributors
# SPDX-License-Identifier: MIT

config SHIELD_NANOKIN
    def_bool $(shields_list_contains,nanokin)
```
